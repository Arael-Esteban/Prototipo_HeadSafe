#include "../firmware/HeadSafe/alarm_core.h"
#include <cstdio>
#define CHECK(x) do { if (!(x)) { std::printf("FAIL line %d: %s\n", __LINE__, #x); return 1; } } while(0)
int main() {
  const uint8_t raw[6]={0x80,0x00,0x7f,0xff,0xff,0xff};
  headsafe::AccelerationSample motion;
  CHECK(!headsafe::parseAcceleration(raw,5,motion));
  CHECK(!headsafe::parseAcceleration(raw,7,motion));
  CHECK(!headsafe::parseAcceleration(nullptr,6,motion));
  CHECK(headsafe::parseAcceleration(raw,6,motion));
  CHECK(motion.ax==-32768 && motion.ay==32767 && motion.az==-1);
  headsafe::AlarmCore c;
  c.sample(32500,32500,0,true,10);
  CHECK(!c.alarm);
  c.sample(-32768,-32768,0,true,20);
  CHECK(c.horizontal==65536 && c.alarm);
  c.sample(1,2,3,true,30);
  CHECK(c.alarm && c.peak==65536 && c.horizontal==3);
  c.sample(0,0,0,false,40);
  CHECK(c.alarm && !c.sensorOk && !c.green());
  CHECK(c.eventCount==1 && c.sequence==1);
  CHECK(c.event(0).value==65536);
  c.reset(50,headsafe::Source::Remote);
  CHECK(!c.alarm && !c.green() && c.sequence==2);
  c.sample(-32768,-32768,4,true,60);
  CHECK(c.alarm && c.sequence==3);
  for(int i=0;i<40;++i) c.reset(100+i,headsafe::Source::Physical);
  CHECK(c.eventCount==32 && c.event(0).id==43 && c.event(31).id==12);
  headsafe::ButtonDebounce b;
  CHECK(!b.update(true,0));
  CHECK(!b.update(false,1));
  CHECK(!b.update(true,5));
  CHECK(!b.update(false,10));
  CHECK(!b.update(false,44));
  CHECK(b.update(false,45));
  CHECK(!b.update(false,500));
  CHECK(!b.update(true,510)); CHECK(!b.update(true,545));
  CHECK(!b.update(false,550)); CHECK(b.update(false,585));
  headsafe::ButtonDebounce wrap;
  CHECK(!wrap.update(false,0xfffffff0)); CHECK(wrap.update(false,20));
  headsafe::ResetCommands commands;
  CHECK(commands.accept("one")==headsafe::CommandResult::New);
  CHECK(commands.accept("one")==headsafe::CommandResult::Duplicate);
  CHECK(commands.accept("")==headsafe::CommandResult::Invalid);
  CHECK(commands.accept("bad id")==headsafe::CommandResult::Invalid);
  char id[20];
  for(int i=1;i<128;++i) { std::snprintf(id,sizeof(id),"id-%d",i); CHECK(commands.accept(id)==headsafe::CommandResult::New); }
  CHECK(commands.accept("one")==headsafe::CommandResult::Duplicate);
  CHECK(commands.accept("overflow")==headsafe::CommandResult::Full);
  CHECK(headsafe::allowedHost("192.168.4.1","192.168.4.1",""));
  CHECK(headsafe::allowedHost("192.168.4.1:80","192.168.4.1",""));
  CHECK(headsafe::allowedHost("192.168.1.9","192.168.4.1","192.168.1.9"));
  CHECK(!headsafe::allowedHost("evil.test","192.168.4.1","192.168.1.9"));
  CHECK(!headsafe::allowedHost("192.168.4.1.evil.test","192.168.4.1",""));
  CHECK(!headsafe::allowedHost("192.168.4.1:81","192.168.4.1",""));
  CHECK(!headsafe::allowedHost("0.0.0.0","0.0.0.0",""));
  CHECK(!headsafe::allowedHost("","192.168.4.1",""));
  CHECK(!headsafe::allowedHost("192.168.4.1:080","192.168.4.1",""));
  CHECK(!headsafe::allowedHost("192.168.4.1\r\n","192.168.4.1",""));
  CHECK(headsafe::sameOrigin("", "192.168.4.1"));
  CHECK(headsafe::sameOrigin("http://192.168.4.1", "192.168.4.1"));
  CHECK(!headsafe::sameOrigin("http://evil.test", "192.168.4.1"));
  CHECK(!headsafe::sameOrigin("http://192.168.4.1.evil.test", "192.168.4.1"));
  char parsed[65];
  CHECK(headsafe::parseCommand(" { \"commandId\" : \"reset-123\" } ",parsed)); CHECK(std::strcmp(parsed,"reset-123")==0);
  CHECK(!headsafe::parseCommand("{}",parsed));
  CHECK(!headsafe::parseCommand("{\"commandId\":true}",parsed));
  CHECK(!headsafe::parseCommand("{\"commandId\":\"a\"} garbage",parsed));
  CHECK(!headsafe::parseCommand("{\"commandId\":\"a\",\"commandId\":\"b\"}",parsed));
  CHECK(!headsafe::parseCommand("{\"commandId\":\"bad\\\"id\"}",parsed));
  headsafe::TonePattern tones;
  CHECK(tones.update(false,0)==0);
  CHECK(tones.update(true,100)==900);
  CHECK(tones.update(true,249)==900);
  CHECK(tones.update(true,250)==600);
  CHECK(tones.update(true,400)==900);
  CHECK(tones.update(false,401)==0);
  CHECK(tones.update(true,402)==900);
  headsafe::TonePattern wrappedTone;
  CHECK(wrappedTone.update(true,0xfffffff0)==900);
  CHECK(wrappedTone.update(true,134)==600);
  headsafe::AlarmCore retryState;
  headsafe::ResetCommands retries;
  retryState.sample(32767,32767,0,true,1);
  if(retries.accept("retry-me")==headsafe::CommandResult::New) retryState.reset(2,headsafe::Source::Remote);
  CHECK(!retryState.alarm);
  retryState.sample(32767,32234,0,true,3);
  CHECK(retryState.alarm && retryState.horizontal==65001);
  if(retries.accept("retry-me")==headsafe::CommandResult::New) retryState.reset(4,headsafe::Source::Remote);
  CHECK(retryState.alarm && retryState.sequence==3);
  std::puts("PASS core: threshold, signed-min, latch, fault/recovery, peak, reset, event ring, debounce/bounce/hold/rollover, command idempotency/capacity/new-impact retry, same-origin, strict JSON, 900/600Hz tones/rollover");
}
